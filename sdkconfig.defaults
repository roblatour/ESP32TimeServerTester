## sdkconfig.defaults
```kconfig
CONFIG_IDF_TARGET_ESP32P4=y
CONFIG_ESPTOOLPY_FLASHSIZE_32MB=y
CONFIG_PARTITION_TABLE_CUSTOM=y
CONFIG_PARTITION_TABLE_CUSTOM_FILENAME="partitions.csv"
CONFIG_ESP_MAIN_TASK_STACK_SIZE=8192
CONFIG_LWIP_IPV6=y
CONFIG_LWIP_IPV6_AUTOCONFIG=y
# Socket headroom for both HTTP servers, mDNS, and protocol tests.
CONFIG_LWIP_MAX_SOCKETS=20
CONFIG_ETH_DMA_RX_BUFFER_NUM=30
CONFIG_ETH_DMA_TX_BUFFER_NUM=30
CONFIG_MDNS_MAX_SERVICES=4
CONFIG_ETH_ENABLED=y
CONFIG_ETH_USE_ESP32_EMAC=y
CONFIG_ETH_TRANSMIT_MUTEX=y
```
